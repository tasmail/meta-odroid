## conf/machine/include/amlogic-meson64.inc
```bitbake
# Amlogic Meson64 Configurations

SOC_FAMILY = "amlogic:meson-gx"
require conf/machine/include/amlogic-meson.inc

XSERVER_append = " xserver-xf86-config"
```

## conf/machine/include/rk3399.inc
```bitbake
# Copyright (C) 2017 Armin Kuster
# Released under the MIT license (see COPYING.MIT for the terms)

SOC_FAMILY = "rk3399"

require conf/machine/include/arm/arch-armv8.inc
require conf/machine/include/soc-family.inc

SERIAL_CONSOLES = "115200;ttyS2"

KERNEL_IMAGETYPE = "Image"

IMAGE_CLASSES += "image_types_odroid"
```

## conf/machine/odroid-c4.conf
```bitbake
#@TYPE: Machine
#@NAME: odroid-c4
#@DESCRIPTION: Machine configuration for odroid-c4 systems
#@MAINTAINER: Armin Kuster <akuster808@gmail.com>

require conf/machine/include/arm/armv8-2a/tune-cortexa55.inc
require conf/machine/include/amlogic-meson64.inc
require conf/machine/include/odroid-arm-defaults.inc

SERIAL_CONSOLE = "115200 ttyS0"

KERNEL_DEVICETREE_FN = "meson64_odroidc4.dtb"
KERNEL_DEVICETREE = "amlogic/meson64_odroidc4.dtb"

UBOOT_BINARY = "u-boot.bin"

UBOOT_MACHINE = "odroid-n2_defconfig"

UBOOT_ENTRYPOINT = "0x1B00000"
UBOOT_LOADADDRESS = "0x1B00000"

#UBOOT_FILE_TITLE = "ODROIDC4-UBOOT-CONFIG"
UBOOT_VIDEO = "no_console_suspend fsck.repair=yes net.ifnames=0 elevator=noop hdmimode=custombuilt cvbsmode=576cvbs max_freq_a55=1908 max_freq_a73= maxcpus=4 voutmode=hdmi modeline=1920,1200,154000,74038,60,1920,1968,2000,2080,1200,1203,1209,1235,1,0,1 disablehpd=false cvbscable= overscan=100  monitor_onoff=false logo=osd0,loaded hdmitx=cec3f sdrmode=auto"

UBOOT_ENV_SUFFIX = "ini"

UBOOT_ENV_CONFIG = "${B}/boot.ini"

IMAGE_BOOT_FILES = "${UBOOT_SCRIPT}"

WKS_FILE ?= "odroid-c4.wks"

EXTRA_IMAGEDEPENDS:remove = " secure-odroid odroid-edid"
```

## conf/machine/odroid-n2-hardkernel.conf
```bitbake
#@TYPE: Machine
#@NAME: odroid-n2
#@DESCRIPTION: Machine configuration for Hardkernel odroid-n2 systems
#@MAINTAINER: Armin Kuster <akuster808@gmail.com>

require conf/machine/include/tune-cortexa73-cortexa53.inc
require conf/machine/include/amlogic-meson64.inc

DEFAULTTUNE ?= "cortexa73-cortexa53-crypto"
require conf/machine/include/odroid-arm-defaults.inc

KERNEL_DEVICETREE_FN = "meson64_odroidn2.dtb"
KERNEL_DEVICETREE = "amlogic/meson64_odroidn2.dtb"
KERNEL_EXTRA_FEATURES = ""

PREFERRED_PROVIDER_virtual/kernel = "linux-hardkernel"
PREFERRED_VERSION_linux-hardkernel ?= "4.9%"

#specify u-boot parameters
PREFERRED_PROVIDER_virtual/bootloader = "u-boot-hardkernel"
PREFERRED_PROVIDER_u-boot = "u-boot-hardkernel"
PREFERRED_VERSION_u-boot-hardkernel = "2015.01"

UBOOT_MACHINE = "odroidn2_config"
UBOOT_BINARY = "u-boot.bin"

KERNEL_IMAGETYPE = "Image.gz"

UBOOT_ENTRYPOINT = "0x01080000"
UBOOT_LOADADDRESS = "0x1080000"

UBOOT_SCRIPT = "boot.ini"
UBOOT_ENV_SUFFIX = "ini"
UBOOT_ENV_CONFIG = "${B}/${UBOOT_ENV}.${UBOOT_ENV_SUFFIX}"

WKS_FILE ?= "odroid-n2.wks"

EXTRA_IMAGEDEPENDS_remove = " secure-odroid odroid-edid"

KERNEL_DEVICETREE_append = "\
    amlogic/overlays/odroidn2/ads7846.dtbo \
    amlogic/overlays/odroidn2/can0.dtbo \
    amlogic/overlays/odroidn2/fanspeed-full.dtbo \
    amlogic/overlays/odroidn2/gpio-joystick0.dtbo \
    amlogic/overlays/odroidn2/gpio-joystick1.dtbo \
    amlogic/overlays/odroidn2/gpio_spdif.dtbo \
    amlogic/overlays/odroidn2/hifishield.dtbo \
    amlogic/overlays/odroidn2/hifishield2.dtbo \
    amlogic/overlays/odroidn2/hktft32.dtbo \
    amlogic/overlays/odroidn2/hktft35.dtbo \
    amlogic/overlays/odroidn2/i2c0.dtbo \
    amlogic/overlays/odroidn2/i2c1.dtbo \
    amlogic/overlays/odroidn2/irblaster.dtbo \
    amlogic/overlays/odroidn2/onewire.dtbo \
    amlogic/overlays/odroidn2/pwm_cd.dtbo \
    amlogic/overlays/odroidn2/pwm_c-pwmfan.dtbo \
    amlogic/overlays/odroidn2/pwm_d-backlight.dtbo \
    amlogic/overlays/odroidn2/pwm_ef.dtbo \
    amlogic/overlays/odroidn2/saradc.dtbo \
    amlogic/overlays/odroidn2/sx865x-i2c1.dtbo \
    amlogic/overlays/odroidn2/spi0.dtbo \
    amlogic/overlays/odroidn2/uart0.dtbo \
    amlogic/overlays/odroidn2/uart1.dtbo \
"

IMAGE_BOOT_FILES += "Image.gz ${@make_dtb_boot_files(d)} config.ini"
```

## conf/machine/odroid-n2.conf
```bitbake
#@TYPE: Machine
#@NAME: odroid-h2
#@DESCRIPTION: Machine configuration for Hardkernel odroid-n2 systems
#@MAINTAINER: Armin Kuster <akuster808@gmail.com>

require conf/machine/include/amlogic-meson64.inc

DEFAULTTUNE ?= "aarch64"
require conf/machine/include/odroid-arm-defaults.inc

KERNEL_DEVICETREE_FN = "meson-g12b-odroid-n2.dtb"
KERNEL_DEVICETREE = "amlogic/meson-g12b-odroid-n2.dtb"
KERNEL_EXTRA_FEATURES = ""

PREFERRED_PROVIDER_virtual/kernel = "linux-yocto-dev"

#specify u-boot parameters
PREFERRED_PROVIDER_virtual/bootloader = "u-boot-hardkernel"
PREFERRED_PROVIDER_u-boot = "u-boot-hardkernel"
PREFERRED_VERSION_u-boot-hardkernel = "2015.01"

UBOOT_MACHINE = "odroidn2_config"
UBOOT_BINARY = "u-boot.bin"

KERNEL_IMAGETYPE = "Image.gz"

UBOOT_ENTRYPOINT = "0x01080000"
UBOOT_LOADADDRESS = "0x1080000"

UBOOT_SCRIPT = "boot.ini"
UBOOT_ENV_SUFFIX = "ini"
UBOOT_ENV_CONFIG = "${B}/${UBOOT_ENV}.${UBOOT_ENV_SUFFIX}"

WKS_FILE ?= "odroid-n2.wks"

EXTRA_IMAGEDEPENDS_remove = " secure-odroid odroid-edid"
```
